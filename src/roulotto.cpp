#include "roulotto.h"
#include <algorithm>
#include <string>
#include <ArduinoJson.h>

#include "CPStore.h"
#include "CyberPartner.h"
#include "ProgressConfig.h"

#include "badge_display.h"
#include "badgeMenu.h"
#include "ccserial.h"
#include "neocontroller.h"

// Sprite frames for the spinning roulette wheel
const uint8_t PROGMEM rouletteFrame1[] = {
	0x00, 0x00, 0x7f, 0xff, 0xff, 0xfe, 0x00, 0x00, 0x00, 0x00, 0x7f, 0xff, 0xff, 0xfe, 0x00, 0x00,
	0x00, 0x00, 0x7f, 0xff, 0xff, 0xfe, 0x00, 0x00, 0x00, 0x00, 0x7f, 0xff, 0xff, 0xfe, 0x00, 0x00,
	0x00, 0x7f, 0xf8, 0x00, 0x00, 0x1f, 0xfe, 0x00, 0x00, 0x7f, 0xf8, 0x00, 0x00, 0x1f, 0xfe, 0x00,
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	0x00, 0x00, 0x7f, 0xff, 0xff, 0xfe, 0x00, 0x00, 0x00, 0x00, 0x7f, 0xff, 0xff, 0xfe, 0x00, 0x00
};

const uint8_t PROGMEM rouletteFrame2[] = {
	0x00, 0x00, 0x7f, 0xff, 0xff, 0xfe, 0x00, 0x00, 0x00, 0x00, 0x7f, 0xff, 0xff, 0xfe, 0x00, 0x00,
	0x00, 0x00, 0x7f, 0xff, 0xff, 0xfe, 0x00, 0x00, 0x00, 0x00, 0x7f, 0xff, 0xff, 0xfe, 0x00, 0x00,
	0x00, 0x7f, 0xf8, 0x00, 0x00, 0x1f, 0xfe, 0x00, 0x00, 0x7f, 0xf8, 0x00, 0x00, 0x1f, 0xfe, 0x00,
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	0x00, 0x00, 0x7f, 0xff, 0xff, 0xfe, 0x00, 0x00, 0x00, 0x00, 0x7f, 0xff, 0xff, 0xfe, 0x00, 0x00
};

const uint8_t PROGMEM rouletteFrame3[] = {
	0x00, 0x00, 0x7f, 0xff, 0xff, 0xfe, 0x00, 0x00, 0x00, 0x00, 0x7f, 0xff, 0xff, 0xfe, 0x00, 0x00,
	0x00, 0x00, 0x7f, 0xff, 0xff, 0xfe, 0x00, 0x00, 0x00, 0x00, 0x7f, 0xff, 0xff, 0xfe, 0x00, 0x00,
	0x00, 0x7f, 0xf8, 0x00, 0x00, 0x1f, 0xfe, 0x00, 0x00, 0x7f, 0xf8, 0x00, 0x00, 0x1f, 0xfe, 0x00,
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	0x00, 0x00, 0x7f, 0xff, 0xff, 0xfe, 0x00, 0x00, 0x00, 0x00, 0x7f, 0xff, 0xff, 0xfe, 0x00, 0x00
};

const uint8_t PROGMEM rouletteFrame4[] = {
	0x00, 0x00, 0x7f, 0xff, 0xff, 0xfe, 0x00, 0x00, 0x00, 0x00, 0x7f, 0xff, 0xff, 0xfe, 0x00, 0x00,
	0x00, 0x00, 0x7f, 0xff, 0xff, 0xfe, 0x00, 0x00, 0x00, 0x00, 0x7f, 0xff, 0xff, 0xfe, 0x00, 0x00,
	0x00, 0x7f, 0xf8, 0x00, 0x00, 0x1f, 0xfe, 0x00, 0x00, 0x7f, 0xf8, 0x00, 0x00, 0x1f, 0xfe, 0x00,
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	0x00, 0x00, 0x7f, 0xff, 0xff, 0xfe, 0x00, 0x00, 0x00, 0x00, 0x7f, 0xff, 0xff, 0xfe, 0x00, 0x00
};

const uint8_t PROGMEM rouletteFrame5[] = {
	0x00, 0x00, 0x7f, 0xff, 0xff, 0xfe, 0x00, 0x00, 0x00, 0x00, 0x7f, 0xff, 0xff, 0xfe, 0x00, 0x00,
	0x00, 0x00, 0x7f, 0xff, 0xff, 0xfe, 0x00, 0x00, 0x00, 0x00, 0x7f, 0xff, 0xff, 0xfe, 0x00, 0x00,
	0x00, 0x7f, 0xf8, 0x00, 0x00, 0x1f, 0xfe, 0x00, 0x00, 0x7f, 0xf8, 0x00, 0x00, 0x1f, 0xfe, 0x00,
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	0x00, 0x00, 0x7f, 0xff, 0xff, 0xfe, 0x00, 0x00, 0x00, 0x00, 0x7f, 0xff, 0xff, 0xfe, 0x00, 0x00
};

const uint8_t PROGMEM rouletteFrame6[] = {
	0x00, 0x00, 0x7f, 0xff, 0xff, 0xfe, 0x00, 0x00, 0x00, 0x00, 0x7f, 0xff, 0xff, 0xfe, 0x00, 0x00,
	0x00, 0x00, 0x7f, 0xff, 0xff, 0xfe, 0x00, 0x00, 0x00, 0x00, 0x7f, 0xff, 0xff, 0xfe, 0x00, 0x00,
	0x00, 0x7f, 0xf8, 0x00, 0x00, 0x1f, 0xfe, 0x00, 0x00, 0x7f, 0xf8, 0x00, 0x00, 0x1f, 0xfe, 0x00,
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	0x00, 0x00, 0x7f, 0xff, 0xff, 0xfe, 0x00, 0x00, 0x00, 0x00, 0x7f, 0xff, 0xff, 0xfe, 0x00, 0x00
};

const uint8_t PROGMEM rouletteFrame7[] = {
	0x00, 0x00, 0x7f, 0xff, 0xff, 0xfe, 0x00, 0x00, 0x00, 0x00, 0x7f, 0xff, 0xff, 0xfe, 0x00, 0x00,
	0x00, 0x00, 0x7f, 0xff, 0xff, 0xfe, 0x00, 0x00, 0x00, 0x00, 0x7f, 0xff, 0xff, 0xfe, 0x00, 0x00,
	0x00, 0x7f, 0xf8, 0x00, 0x00, 0x1f, 0xfe, 0x00, 0x00, 0x7f, 0xf8, 0x00, 0x00, 0x1f, 0xfe, 0x00,
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	0x00, 0x00, 0x7f, 0xff, 0xff, 0xfe, 0x00, 0x00, 0x00, 0x00, 0x7f, 0xff, 0xff, 0xfe, 0x00, 0x00
};

const uint8_t PROGMEM rouletteFrame8[] = {
	0x00, 0x00, 0x7f, 0xff, 0xff, 0xfe, 0x00, 0x00, 0x00, 0x00, 0x7f, 0xff, 0xff, 0xfe, 0x00, 0x00,
	0x00, 0x00, 0x7f, 0xff, 0xff, 0xfe, 0x00, 0x00, 0x00, 0x00, 0x7f, 0xff, 0xff, 0xfe, 0x00, 0x00,
	0x00, 0x7f, 0xf8, 0x00, 0x00, 0x1f, 0xfe, 0x00, 0x00, 0x7f, 0xf8, 0x00, 0x00, 0x1f, 0xfe, 0x00,
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	0x00, 0x00, 0x7f, 0xff, 0xff, 0xfe, 0x00, 0x00, 0x00, 0x00, 0x7f, 0xff, 0xff, 0xfe, 0x00, 0x00
};

// Array of frames
const uint8_t* const rouletteFrames[] = {
    rouletteFrame1,
    rouletteFrame2,
    rouletteFrame3,
    rouletteFrame4,
    rouletteFrame5,
    rouletteFrame6,
    rouletteFrame7,
    rouletteFrame8
};

static uint8_t frameIndex = 0;
static uint32_t frameSpeed = 0;
static uint32_t lastFrameTime = 0;

// Define the singleton instance
ROULOTTO& ROULOTTO::getInstance() {
    static ROULOTTO instance;
    return instance;
}

// Define static members
uint16_t ROULOTTO::bannerTicker = 0;

bool ROULOTTO::isGreen(int number) {
    // Handle special cases for 0, 00, and 000
    if (number == 0 || number == 37 || number == 38) {
        return true; // Neither red nor black
    }
    return false;
}

bool ROULOTTO::isRed(int number) {
    // Handle special cases for 0, 00, and 000
    if (isGreen(number)) {
        return false; // Neither red nor black
    }

    // Check if the number is in the red set
    return std::find(std::begin(ROULOTTO::redNumbers), std::end(ROULOTTO::redNumbers), number) != std::end(ROULOTTO::redNumbers);
}

std::string ROULOTTO::getColorOfNumber(int number) {
    if (isGreen(number)) {
        return "Grn";
    } else if (isRed(number)) {
        return "Red";
    } else {
        return "Blk";
    }
}

std::string ROULOTTO::betToString(int insideBet, int outsideBet) {
    Serial.printf("[ROULOTTO - B2S] Inside Bet: %d, Outside Bet: %d\n", insideBet, outsideBet);
    if (insideBet != -1) {
        return "Inside " + std::to_string(insideBet);
    }
    switch (outsideBet) {
        case 1: return "Outside Red";
        case 2: return "Outside Black";
        case 3: return "Outside Even";
        case 4: return "Outside Odd";
        case 5: return "Outside High";
        case 6: return "Outside Low";
        default: return "Unknown";
    }
}

std::string ROULOTTO::spinToString(int spinResult) {
    Serial.printf("[ROULOTTO - S2S] spinResult: %d\n", spinResult);
    if (spinResult == 0) {
        return "0";
    } else if (spinResult == 37) {
        return "00";
    } else if (spinResult == 38) {
        return "000";
    } else {
        return std::to_string(spinResult);
    }
}



int ROULOTTO::spinWheel() {
    // Ensure playerMoney is not zero to avoid division by zero
    if (playerMoney < 5  || currentBetAmount > playerMoney) {
        Serial.println("[ROULOTTO - SW] Error: Not enough money to bet.");
        return -1; // Error case, no money to bet
    }

    // Calculate the percentage of money bet
    float betPercentage = static_cast<float>(currentBetAmount) / playerMoney;

    // Total weight for green values and 17
    float specialWeight = betPercentage * 100.0f; // Scale to percentage
    float singleSpecialWeight = specialWeight / 4.0f; // Divide equally among 0, 00, 000, and 17

    // Initialize weights for all numbers (0 to 38)
    std::vector<float> weights(39, 1.0f); // Default weight is 1.0 for all numbers

    // Adjust weights for green values and 17
    weights[0] += singleSpecialWeight;  // Green: 0
    weights[37] += singleSpecialWeight; // Green: 00
    weights[38] += singleSpecialWeight; // Green: 000
    weights[17] += singleSpecialWeight; // Black: 17

    // Calculate the total weight
    float totalWeight = 0.0f;
    for (float weight : weights) {
        totalWeight += weight;
    }

    // Generate a random number based on the weights
    float randomValue = static_cast<float>(random(0, 10000)) / 10000.0f * totalWeight;

    // Determine the winning number
    float cumulativeWeight = 0.0f;
    for (int i = 0; i < weights.size(); i++) {
        cumulativeWeight += weights[i];
        if (randomValue <= cumulativeWeight) {
            return i; // Winning number
        }
    }

    return -1; // Should never reach here
}

bool ROULOTTO::isWinningBet(int insideBet, int outsideBet, int spinResult) {
    Serial.printf("[ROULOTTO - IWB] Inside Bet: %d, Outside Bet: %d, spin: %d\n", insideBet, outsideBet, spinResult);
    //Check if the house won
    if (isGreen(spinResult)){
        return false;
    }

    // Check if the inside bet matches the spin result
    if (insideBet == spinResult) {
        return true; // Inside bet wins
    }

    // Check if the outside bet matches the spin result
    if (outsideBet == 1 && isRed(spinResult)) {
        return true; // Outside bet wins (Red)
    } else if (outsideBet == 2 && !isRed(spinResult)) {
        return true; // Outside bet wins (Black)
    } else if (outsideBet == 3 && spinResult % 2 == 0) {
        return true; // Outside bet wins (Even)
    } else if (outsideBet == 4 && spinResult % 2 != 0) {
        return true; // Outside bet wins (Odd)
    } else if (outsideBet == 5 && spinResult > 18) {
        return true; // Outside bet wins (High)
    } else if (outsideBet == 6 && spinResult <= 18) {
        return true; // Outside bet wins (Low)
    }

    return false; // No winning bet
}



void ROULOTTO::runRoulotto( void ){
    NeoController& neo = NeoController::getInstance();

    //handle banner expirations first
    // Title Banner expired
    if (currentState == RLGameState::RL_TITLE_BANNER) {
        if (bannerTicker >= 120) {
            BDISPLAY::clearAndDisplayBatteryPercentage();
            neo.turnAllOff();
            currentState = RLGameState::RL_SELECT_BET_TYPE;
            bannerTicker = 0;
            // If you can't make the minimum bet, TAKE YO BROKE ASS HOME
            if (playerMoney < 5) {
                spinResult = -1; // Error condition
                currentState = RLGameState::RL_DISPLAY_RESULT;
            }
        }
    } else if (currentState == RLGameState::RL_SELECT_BET_TYPE) {
        if (confirmation) {
            if (1+(inputIndex % 2) == 1) {
                currentState = RLGameState::RL_SELECT_INSIDE_BET;
            } else {
                currentState = RLGameState::RL_SELECT_OUTSIDE_BET;
            }
            BDISPLAY::clearAndDisplayBatteryPercentage();
            neo.turnAllOff();
            bannerTicker = 0;
            confirmation = false;
            inputIndex = 0;
        }
    } else if (currentState == RLGameState::RL_SELECT_INSIDE_BET) {
        if (confirmation) {
            BDISPLAY::clearAndDisplayBatteryPercentage();
            neo.turnAllOff();
            insideBetSelected = 1+(inputIndex % 36);
            currentState = RLGameState::RL_INPUT_BET_AMOUNT;
            bannerTicker = 0;
            confirmation = false;
            inputIndex = 0;
        }
    } else if (currentState == RLGameState::RL_SELECT_OUTSIDE_BET) {
        if (confirmation) {
            BDISPLAY::clearAndDisplayBatteryPercentage();
            neo.turnAllOff();
            insideBetSelected = -1; // Negative inside bets are a flag for outside bets
            outsideBetSelected = 1+(inputIndex % 6);
            currentState = RLGameState::RL_INPUT_BET_AMOUNT;
            bannerTicker = 0;
            confirmation = false;
            inputIndex = 0;
        }
    } else if (currentState == RLGameState::RL_INPUT_BET_AMOUNT) {
        if (confirmation) {
            BDISPLAY::clearAndDisplayBatteryPercentage();
            neo.turnAllOff();
            currentState = RLGameState::RL_SPIN_WHEEL;
            currentBetAmount = (1+inputIndex) * 5;
            Serial.printf("[ROULOTTO - IBA] Bet Amount: %d @idx: %d\n", currentBetAmount, inputIndex);
            bannerTicker = 0;
            confirmation = false;
            inputIndex = 0;
        }
    } else if (currentState == RLGameState::RL_SPIN_WHEEL) {
        if (bannerTicker >= 150) {
            BDISPLAY::clearAndDisplayBatteryPercentage();
            neo.turnAllOff();
            currentState = RLGameState::RL_DISPLAY_RESULT;
            bannerTicker = 0;
            confirmation = false;
            inputIndex = 0;
        }
    } else if (currentState == RLGameState::RL_DISPLAY_RESULT) {
        if (bannerTicker >= 160) {
            BDISPLAY::clearAndDisplayBatteryPercentage();
            neo.turnAllOff();
            doStop();
        }
    }
    //then print banners, start timers, handle nonbanner game states
    if (currentState == RLGameState::RL_TITLE_BANNER) {
        if (bannerTicker < 1) {
            neo.changeRoulotto();
            BDISPLAY::clearAndDisplayBatteryPercentage();
            BDISPLAY::display.setTextColor(WHITE);
            BDISPLAY::display.setCursor(0, 0);
            BDISPLAY::display.setTextSize(1);
            BDISPLAY::display.println();
            BDISPLAY::display.setTextSize(2);
            BDISPLAY::display.println(F(" Roulotto"));
            BDISPLAY::display.setTextSize(1);
            BDISPLAY::display.println(F(""));
            BDISPLAY::display.println(F("   Minimum play $5"));
            BDISPLAY::display.println(F(""));
            BDISPLAY::display.println(F("\"May the odds be ever"));
            BDISPLAY::display.println(F("   in your favor\""));
            BDISPLAY::display.display();
        }
        bannerTicker++;
    } else if (currentState == RLGameState::RL_SELECT_BET_TYPE) {
        if (bannerTicker % 5 == 0) {
            BDISPLAY::clearAndDisplayBatteryPercentage();
            BDISPLAY::display.setTextSize(1);
            BDISPLAY::display.setTextColor(WHITE);
            BDISPLAY::display.setCursor(0, 0);
            BDISPLAY::display.println();
            BDISPLAY::display.printf("Selected Option: %d\n", 1+(inputIndex%2));
            BDISPLAY::display.setTextSize(1);
            BDISPLAY::display.println(F(""));
            BDISPLAY::display.println(F("1. Inside Bet (35:1)"));
            BDISPLAY::display.println(F("2. Outside Bet (1:1)"));
            BDISPLAY::display.display();
        }
        bannerTicker++;
    } else if (currentState == RLGameState::RL_SELECT_INSIDE_BET) {
        if (bannerTicker % 5 == 0) {
            BDISPLAY::clearAndDisplayBatteryPercentage();
            BDISPLAY::display.setTextSize(1);
            BDISPLAY::display.setTextColor(WHITE);
            BDISPLAY::display.setCursor(0, 0);
            BDISPLAY::display.setTextSize(1);
            BDISPLAY::display.println(F("Select a Number:"));
            BDISPLAY::display.println(F(""));
            BDISPLAY::display.setTextSize(2);
            BDISPLAY::display.printf("  %d", 1+(inputIndex%36));
            BDISPLAY::display.display();
        }
        bannerTicker++;
    } else if (currentState == RLGameState::RL_SELECT_OUTSIDE_BET) {
        if (bannerTicker % 5 == 0) {
            BDISPLAY::clearAndDisplayBatteryPercentage();
            BDISPLAY::display.setTextSize(1);
            BDISPLAY::display.setTextColor(WHITE);
            BDISPLAY::display.setCursor(0, 0);
            BDISPLAY::display.setTextSize(1);
            BDISPLAY::display.printf("Selected Option: %d\n", 1+(inputIndex%6));
            BDISPLAY::display.println(F(""));
            BDISPLAY::display.println(F("1. Red"));
            BDISPLAY::display.println(F("2. Black"));
            BDISPLAY::display.println(F("3. Even"));
            BDISPLAY::display.println(F("4. Odd"));
            BDISPLAY::display.println(F("5. High"));
            BDISPLAY::display.println(F("6. Low"));
            BDISPLAY::display.display();
        }
        bannerTicker++;
    } else if (currentState == RLGameState::RL_INPUT_BET_AMOUNT) {
        if (bannerTicker % 5 == 0) {
            BDISPLAY::clearAndDisplayBatteryPercentage();
            BDISPLAY::display.setTextSize(1);
            BDISPLAY::display.setTextColor(WHITE);
            BDISPLAY::display.setCursor(0, 0);
            BDISPLAY::display.setTextSize(1);
            BDISPLAY::display.println(F(" Bet w/ $5 chips"));
            BDISPLAY::display.setTextSize(2);
            BDISPLAY::display.printf("\n  $%d\n", (1+(inputIndex))*5);
            BDISPLAY::display.setTextSize(1);
            BDISPLAY::display.printf("\n (You got $%d)", playerMoney);
            BDISPLAY::display.display();
        }
        bannerTicker++;
    } else if (currentState == RLGameState::RL_SPIN_WHEEL) {
        // This check is redundant and likely never realized, but better safe than sorry
        if (currentBetAmount > playerMoney) {
            if (bannerTicker < 1) {
                neo.changeRed();
                BDISPLAY::clearAndDisplayBatteryPercentage();
                BDISPLAY::display.setTextSize(2);
                BDISPLAY::display.setTextColor(WHITE);
                BDISPLAY::display.setCursor(0, 0);
                BDISPLAY::display.println(F(""));
                BDISPLAY::display.println(F("BROKE ASS!"));
                BDISPLAY::display.setTextSize(1);
                BDISPLAY::display.println(F(""));
                BDISPLAY::display.println(F("Don't bet more money than you have..."));
                BDISPLAY::display.display();
            }
        } else {
            if (bannerTicker < 1) {
                neo.changeRoulotto();
                spinResult = spinWheel();
            }
            // Slow the animation down the longer it runs
            if (bannerTicker == 0) {
                frameSpeed = 60;
            } else if (bannerTicker == 50) {
                frameSpeed = 180;
            } else if (bannerTicker == 100) {
                frameSpeed = 360;
            }

            // Animate the spinning wheel
            if (millis() - lastFrameTime >= frameSpeed) {
                lastFrameTime = millis();

                // Clear the display, Draw the current frame, and iterate frame index
                BDISPLAY::clearAndDisplayBatteryPercentage();
                BDISPLAY::display.drawBitmap(
                    32, 0, // X, Y position
                    rouletteFrames[frameIndex], // Current frame
                    64, 64, // Width and height
                    WHITE // Color
                );
                BDISPLAY::display.display();
                frameIndex = (frameIndex + 1) % 8;
            }
        }
        bannerTicker++;
    } else if (currentState == RLGameState::RL_DISPLAY_RESULT) {
        // Logic for matching player bet against spinResult
        // Increment/decremnet playerMoney
        if (bannerTicker < 1) {
            BDISPLAY::clearAndDisplayBatteryPercentage();
            BDISPLAY::display.setTextColor(WHITE);
            BDISPLAY::display.setTextSize(1);
            BDISPLAY::display.setCursor(0, 0);
            // Handle ERROR case first
            if (spinResult == -1) {
                neo.changePopo();
                BDISPLAY::display.setTextSize(2);
                BDISPLAY::display.println(F("Your IP"));
                BDISPLAY::display.println(F(" Address"));
                BDISPLAY::display.setTextSize(1);
                BDISPLAY::display.println(F("has been logged."));
                BDISPLAY::display.println(F(""));
                BDISPLAY::display.println(F("An administrator has been notified."));
            // Print your bet on the top line, Spin on the next line, both small
            } else {
                BDISPLAY::display.printf("\nBet %S @$%d\n",
                    betToString(insideBetSelected, outsideBetSelected).c_str(), currentBetAmount);
                BDISPLAY::display.printf("Spun %S %S\n\n",
                    spinToString(spinResult).c_str(), getColorOfNumber(spinResult).c_str());
                BDISPLAY::display.setTextSize(2);
            }
            // Then for winners, print the result (large). Value gained (small)
            if (isWinningBet(insideBetSelected, outsideBetSelected, spinResult)) {
                neo.changeGreen();
                BDISPLAY::display.println(F("WINNER!"));
                BDISPLAY::display.setTextSize(1);

                // Won a 35:1 bet
                if (insideBetSelected != -1) {
                    CPStore::increaseMoney(currentBetAmount * 35);
                    playerMoney = CPStore::getInstance().getMoney();
                    BDISPLAY::display.printf("\n+$%d, Now ya got $%d", currentBetAmount * 35, playerMoney);
                    if (!ProgressConfig::isBeatRoulottoUnlocked()) {
                        Serial.printf("You have no idea how lucky you just got. Achievement Unlocked!\n");
                        ProgressConfig::unlockBeatRoulotto();
                        ProgressConfig::saveProgressFile();
                    }
                // Won a 1:1 bet
                } else {
                    CPStore::increaseMoney(currentBetAmount);
                    playerMoney = CPStore::getInstance().getMoney();
                    BDISPLAY::display.printf("\n+$%d, Now ya got $%d", currentBetAmount, playerMoney);
                }
            // Otherwise for losers, print the result (large), and value lost (small)
            } else {
                neo.changeRed();
                BDISPLAY::display.println(F("LOSER!"));
                BDISPLAY::display.setTextSize(1);
                CPStore::decreaseMoney(currentBetAmount, true);
                playerMoney = CPStore::getInstance().getMoney();
                BDISPLAY::display.printf("\n-$%d, Now ya got $%d", currentBetAmount, playerMoney);
            }
            BDISPLAY::display.display();

            // Tell the backend about the game
            JsonDocument doc;
            doc["game"] = "roulotto";
            doc["betAmount"] = currentBetAmount;
            doc["betType"] = betToString(insideBetSelected, outsideBetSelected);
            doc["won"] = isWinningBet(insideBetSelected, outsideBetSelected, spinResult);
            CyberPartner::getInstance().queueGeneralUpdate("cp/game/play", doc);
        }
        bannerTicker++;
    }
}




/**
 * @brief Updates the Roulotto game state.
 * @note This function should be called periodically to keep the game running.
 *       It handles the game logic and updates the display accordingly.
 *       It is not thread-safe and should be used in a single-threaded context.
 */
void ROULOTTO::update( void ){
    if (currentState != RLGameState::RL_DISABLED) {
        if (_gameTimer.check(RL_CHECK_TIME_INTERVAL)) {
            runRoulotto();
        }
    }
}

/**
 * @brief Starts the Roulotto game.
 * @note This function disables the menu before initializing required variables to starting the game.
 */
void ROULOTTO::doStart( void ){
    BMenu::disableMenu();
    currentState = RLGameState::RL_TITLE_BANNER;
    bannerTicker = 0;

    playerMoney = CPStore::getInstance().getMoney();
    rlPatternSeed = millis() + ESP.getCycleCount();  // uptime + CPU cycle count, yuge variation
    randomSeed(rlPatternSeed);
}

/**
 * @brief Stops the Roulotto game.
 * @note This function should clear any game-related variables and re-enables the menu.
 */
void ROULOTTO::doStop( void ){
    currentState = RLGameState::RL_DISABLED;
    bannerTicker = 0;
    inputIndex = 0;
    currentBetAmount = 0;
    insideBetSelected = -1;
    outsideBetSelected = 0;
    spinResult = 0;

    rlPatternSeed = 0;
    randomSeed(rlPatternSeed);  // ~deseed random

    NeoController::getInstance().turnAllOff();
    // TODO optional networking things here
    BMenu::enableMenu();  // enable menu since we are done
}

/**
 * @brief Checks if the Roulotto game is currently running.
 * @return True if the game is running, false otherwise.
 */
bool ROULOTTO::isRunning( void ){
    if (currentState == RLGameState::RL_DISABLED) {
        return false;
    } else {
        return true;
    }
}

/**
 * @brief Handles the up button click for the Roulotto game.
 */
void ROULOTTO::clickUp( void ){
    inputIndex++;
    if (currentState != RLGameState::RL_INPUT_BET_AMOUNT) {
        if (inputIndex > 35) {
            inputIndex = 0;
        }
    } else {
        if ((1+inputIndex)*5 > playerMoney) {
            inputIndex = 0;
        }
    }
}

/**
 * @brief Handles the down button click for the Roulotto game.
 */
void ROULOTTO::clickDown( void ){
    if (currentState != RLGameState::RL_INPUT_BET_AMOUNT) {
        if (inputIndex <= 0) {
            inputIndex = 35;
        }
    // If we're inputting bets and input index is below zero,
    // find the highest legal bet
    } else if (inputIndex <= 0) {
        inputIndex = (playerMoney / 5); // Max chips that fit within playerMoney
    }
    inputIndex--;
}

/**
 * @brief Handles the confirm button click for the Roulotto game.
 */
void ROULOTTO::clickConfirm( void ){
    if (currentState == RLGameState::RL_SELECT_BET_TYPE) {
        confirmation = true;
    } else if (currentState == RLGameState::RL_SELECT_INSIDE_BET) {
        confirmation = true;
    } else if (currentState == RLGameState::RL_SELECT_OUTSIDE_BET) {
        confirmation = true;
    } else if (currentState == RLGameState::RL_INPUT_BET_AMOUNT) {
        confirmation = true;
    }
}

/**
 * @brief Handles the cancel button click for the Roulotto game.
 */
void ROULOTTO::clickCancel( void ){
    if (currentState == RLGameState::RL_TITLE_BANNER) {
        doStop();
    } else if (currentState == RLGameState::RL_SELECT_BET_TYPE) {
        currentState = RLGameState::RL_TITLE_BANNER;
    } else if (currentState == RLGameState::RL_SELECT_INSIDE_BET) {
        currentState = RLGameState::RL_SELECT_BET_TYPE;
    } else if (currentState == RLGameState::RL_SELECT_OUTSIDE_BET) {
        currentState = RLGameState::RL_SELECT_BET_TYPE;
    } else if (currentState == RLGameState::RL_INPUT_BET_AMOUNT) {
        currentState = RLGameState::RL_SELECT_BET_TYPE;
    } else if (currentState == RLGameState::RL_DISPLAY_RESULT) {
        doStop();
    }
}